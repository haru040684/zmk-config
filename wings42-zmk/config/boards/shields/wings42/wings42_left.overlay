#include "wings42.dtsi"

/*
 * Left half: matrix columns 0-5, physical left -> right.
 * QMK cols: B3, B1, F7, F6, F5, F4
 */
&kscan0 {
    col-gpios
        = <&pro_micro 14 GPIO_ACTIVE_HIGH>  /* B3 */
        , <&pro_micro 15 GPIO_ACTIVE_HIGH>  /* B1 */
        , <&pro_micro 18 GPIO_ACTIVE_HIGH>  /* F7 (A0) */
        , <&pro_micro 19 GPIO_ACTIVE_HIGH>  /* F6 (A1) */
        , <&pro_micro 20 GPIO_ACTIVE_HIGH>  /* F5 (A2) */
        , <&pro_micro 21 GPIO_ACTIVE_HIGH>  /* F4 (A3) */
        ;
};
