## wings42-zmk/config/boards/shields/wings42/Kconfig.shield
```kconfig
config SHIELD_WINGS42_LEFT
	def_bool $(shields_list_contains,wings42_left)

config SHIELD_WINGS42_RIGHT
	def_bool $(shields_list_contains,wings42_right)
```
